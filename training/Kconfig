## training/Kconfig
```kconfig
menuconfig GL_TRAINING
	bool "GL Kernel drivers training"
	help
	  You can build and test GL training kernel drivers

if GL_TRAINING

config GL_TRAINING_HELLOWORLD
	tristate "Build hello world example(Lesson 2)"
	help
	  This build hello world example from Lesson 2.

config GL_TRAINING_HELLO_DEBUGFS
	tristate "Build hello debugfs example(Lesson 3)"
	help
	  This build hello debugfs example from Lesson 3.

endif # GL_TRAINING
```
